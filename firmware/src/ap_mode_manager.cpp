// ═══════════════════════════════════════════════════════════════════════════════
//  ap_mode_manager.cpp — AP Mode core
// ═══════════════════════════════════════════════════════════════════════════════
#include "ap_mode_manager.h"
#include "web_vault_server.h"  // WebVaultServer
#include "vault_manager.h"
#include "crypto_utils.h"  // secureZero, secureRandom
#include <esp_mac.h>
#include <esp_wifi.h>
#include <cstring>

// 31-char "no-confusable" alphabet (no O/0/I/1) — matches SecureKey exactly.
const char* const AP_WPA2_ALPHABET = "ABCDEFGHJKLMNPQRSTUVWXYZ23456789";
#define AP_WPA2_ALPHABET_LEN 31

APModeManager& APModeManager::getInstance() {
  static APModeManager instance;
  // F8: If getInstance() is called before explicit begin(), auto-initialize
  // with a warning. This is a safe fallback — the instance is just an empty
  // shell until start() is called, so early access doesn't corrupt state.
  if (!instance._initialized) {
    Serial.println("[F8-WARN] APModeManager::getInstance() called before begin() — auto-initializing");
    instance._initialized = true;
  }
  return instance;
}

bool APModeManager::begin() {
  if (_initialized) return true;  // idempotent
  Serial.println("[F8] APModeManager::begin() — initialized");
  _initialized = true;
  return true;
}

void APModeManager::_buildSsidFromMac() {
  // v5.4.3: SSID uses a random 4-hex-char suffix instead of MAC-based,
  // so regenerateCredentials() actually produces a new SSID. The prefix
  // "SecureVault-" stays constant for device recognizability.
  uint32_t suffix = esp_random() & 0xFFFF;
  snprintf(_ssid, sizeof(_ssid), "%s%04X", AP_SSID_PREFIX, suffix);
}

void APModeManager::_generateSsid() {
  _buildSsidFromMac();
}

void APModeManager::_generateWpa2Password() {
  // 8 chars from the 31-char alphabet via esp_random().
  for (int i = 0; i < AP_WPA2_PASSWORD_LEN; i++) {
    _wpa2Password[i] = AP_WPA2_ALPHABET[esp_random() % AP_WPA2_ALPHABET_LEN];
  }
  _wpa2Password[AP_WPA2_PASSWORD_LEN] = '\0';
}

void APModeManager::_generateCode() {
  // 6-digit code via esp_random(). Note: WebAuthManager also generates
  // the code (and the SHA-256 proof) — we keep a copy here for the
  // TFT display, and WebAuthManager stores its own copy for the proof
  // verification. Both are zeroed on stop().
  uint32_t n = esp_random() % 1000000UL;
  snprintf(_code, sizeof(_code), "%06lu", (unsigned long)n);
}

void APModeManager::suspendBLE() {
  if (_ble) {
    // v5.4: BleKeyboardManager::end() tears down the NimBLE stack cleanly.
    // resume() will re-init with the same device name on AP-mode stop.
    _ble->end();
    _bleWasSuspended = true;
  }
}

void APModeManager::restoreBLE() {
  if (_ble && _bleWasSuspended) {
    _ble->resume();
    _bleWasSuspended = false;
  }
}

// ═══════════════════════════════════════════════════════════════════════════════
//  v5.4.8: REVERTED to synchronous start/stop. The async background task
//  approach (v5.4.7) was crashing because it accessed shared state (_vault,
//  _ble, WiFi stack) from a separate FreeRTOS task without synchronization,
//  and the 8KB stack was too small for WiFi+NimBLE operations. The original
//  synchronous approach works reliably — the 2-3 second delay is acceptable
//  and far better than crashes + black screens.
// ═══════════════════════════════════════════════════════════════════════════════
bool APModeManager::start(VaultManager* vault, SessionContext* sessionCtx, BleKeyboardManager* ble) {
  if (_active) return true;
  if (!vault || !sessionCtx || !ble) return false;
  _vault = vault;
  _ble = ble;
  // F6: Store SessionContext pointer — PIN is read from here when needed.
  // No local _pin copy anymore.
  _sessionCtx = sessionCtx;
  return _doStart();
}

void APModeManager::stop() {
  if (!_active) return;
  _doStop();
}

bool APModeManager::regenerateCredentials() {
  if (!_active) return false;
  return _doRegenerate();
}

// ═══════════════════════════════════════════════════════════════════════════════
//  _doStart — the actual blocking start (runs on the background task)
// ═══════════════════════════════════════════════════════════════════════════════
bool APModeManager::_doStart() {

  // 1. Suspend BLE (shared 2.4GHz radio coexistence — see study_securekey_dynamic_password.md §1.5).
  suspendBLE();

  // 2. Generate per-session credentials.
  //    SSID is derived from the chip MAC (deterministic per device).
  //    WPA2 password is 8 random chars from the no-confusable alphabet.
  //    The 6-digit code is generated by WebAuthManager below (step 6) —
  //    it computes the SHA-256 proof at the same time, and we mirror
  //    the code into _code for the TFT display.
  _generateSsid();
  _generateWpa2Password();

  // 3. Bring up the SoftAP.
  WiFi.mode(WIFI_AP);
  // softAP signature: softAP(ssid, passphrase, channel, hidden, max_clients)
  if (!WiFi.softAP(_ssid, _wpa2Password, 1, 0, AP_MAX_CLIENTS)) {
    // Failure — clean up and bail.
    restoreBLE();
    return false;
  }
  // Cap TX power to 8.5 dBm (phone is inches away, default 19.5 dBm
  // is unnecessary and causes current-spike resets on battery).
  WiFi.setTxPower(AP_TX_POWER_DBM);

  // 4. DNS hijack — every hostname resolves to the AP IP (192.168.4.1).
  // This is what makes the phone's captive-portal sheet pop up
  // automatically.
  _dnsServer.setErrorReplyCode(DNSReplyCode::NoError);
  _dnsServer.start(53, "*", WiFi.softAPIP());
  _dnsRunning = true;

  // 5. mDNS — device is reachable as securevault-<last4hex>.local
  // (avoids typing 192.168.4.1). Last 4 hex of MAC for uniqueness.
  uint8_t mac[6] = {0};
  esp_read_mac(mac, ESP_MAC_WIFI_SOFTAP);
  char mdnsName[16];
  snprintf(mdnsName, sizeof(mdnsName), "securevault-%02x%02x", mac[4], mac[5]);
  // v5.4: mDNS intentionally skipped (see ap_mode_manager.h comment).
  // The DNS hijack in step 4 already makes every hostname resolve
  // to 192.168.4.1, which is functionally equivalent for the
  // captive-portal use case. The user can type "192.168.4.1" OR
  // "securevault.local" OR any hostname — they all work.
  // The mDNS code is left here commented-out for reference if mDNS
  // support is ever added back (e.g. by vendoring the mdns component
  // under components/ like esp_tinyusb already is).
  // if (mdns_init() == ESP_OK) {
  //   mdns_hostname_set(mdnsName);
  //   mdns_service_add(NULL, "_http", "_tcp", 80, NULL, 0);
  //   _mdnsRunning = true;
  // }

  // 6. Initialize the 6-layer stack (in dependency order).
  //    WebAuthManager generates BOTH the 6-digit code AND its SHA-256
  //    proof (used to verify /api/login requests without the raw code
  //    crossing the wire). We mirror the same code into our _code field
  //    for the TFT display — they MUST match, since the user reads
  //    _code off the TFT and types it into the webapp.
  WebAuthManager::getInstance().begin();
  WebAuthManager::getInstance().generateCode();
  strncpy(_code, WebAuthManager::getInstance().code(), AP_CODE_LEN);
  _code[AP_CODE_LEN] = '\0';

  SecureLayerManager::getInstance().begin();
  URLObfuscationManager::getInstance().begin();
  MethodTunnelingManager::getInstance().begin();
  HeaderObfuscationManager::getInstance().begin();
  TrafficObfuscationManager::getInstance().begin();

  // 7. Register the obfuscated URL mappings for each endpoint we'll
  // expose. The webapp learns these mappings via /api/secure/hello.
  URLObfuscationManager::getInstance().registerEndpoint("/api/vault/list");
  URLObfuscationManager::getInstance().registerEndpoint("/api/vault/add");
  URLObfuscationManager::getInstance().registerEndpoint("/api/vault/edit");
  URLObfuscationManager::getInstance().registerEndpoint("/api/vault/delete");
  URLObfuscationManager::getInstance().registerEndpoint("/api/tunnel");

  // Register which endpoints must be tunneled (PUT/DELETE — Layer 4).
  MethodTunnelingManager::getInstance().registerTunneledEndpoint("/api/vault/edit");
  MethodTunnelingManager::getInstance().registerTunneledEndpoint("/api/vault/delete");

  // F6: Start the web server with SessionContext — PIN read from there.
  _webServer = new WebVaultServer();
  if (!_webServer || !_webServer->begin(_vault, _sessionCtx)) {
    // Failure — clean up everything we brought up.
    if (_webServer) { delete _webServer; _webServer = nullptr; }
    TrafficObfuscationManager::getInstance().end();
    HeaderObfuscationManager::getInstance().end();
    MethodTunnelingManager::getInstance().end();
    URLObfuscationManager::getInstance().end();
    SecureLayerManager::getInstance().end();
    WebAuthManager::getInstance().end();
    // mDNS never started (intentionally skipped — see start() comment).
    // _mdnsRunning stays false; nothing to tear down here.
    if (_dnsRunning) { _dnsServer.stop(); _dnsRunning = false; }
    WiFi.softAPdisconnect(true);
    WiFi.mode(WIFI_OFF);
    restoreBLE();
    // F6: No local _pin to zero — just release the reference.
    _sessionCtx = nullptr;
    _vault = nullptr;
    _ble = nullptr;
    return false;
  }

  _lastActivity = millis();
  _active = true;
  return true;
}

void APModeManager::_doStop() {
  if (!_active) return;

  // Tear down in reverse order of start().
  if (_webServer) {
    _webServer->end();
    delete _webServer;
    _webServer = nullptr;
  }

  TrafficObfuscationManager::getInstance().end();
  HeaderObfuscationManager::getInstance().end();
  MethodTunnelingManager::getInstance().end();
  URLObfuscationManager::getInstance().end();
  SecureLayerManager::getInstance().end();  // zeroes ECDH keypair + all session keys
  WebAuthManager::getInstance().end();      // zeroes 6-digit code + all sessions

  // mDNS never started (intentionally skipped — see start() comment).
  // _mdnsRunning stays false; nothing to tear down here.
  // if (_mdnsRunning) { mdns_free(); _mdnsRunning = false; }
  if (_dnsRunning) {
    _dnsServer.stop();
    _dnsRunning = false;
  }

  WiFi.softAPdisconnect(true);
  WiFi.mode(WIFI_OFF);

  restoreBLE();

  // Zero the per-session credentials.
  secureZero(_ssid, sizeof(_ssid));
  secureZero(_wpa2Password, sizeof(_wpa2Password));
  secureZero(_code, sizeof(_code));
  // F6: No local _pin to zero — SessionContext owns the PIN.
  // Just release our pointer reference.
  _sessionCtx = nullptr;

  _vault = nullptr;
  _ble = nullptr;
  _active = false;
}

void APModeManager::noteActivity() {
  _lastActivity = millis();
}

void APModeManager::tick() {
  if (!_active) return;

  // 1. DNS hijack — process pending DNS queries (captive portal pop-up).
  if (_dnsRunning) {
    _dnsServer.processNextRequest();
  }

  // 2. mDNS — ESPmDNS doesn't have a per-tick process method (it
  // runs on its own FreeRTOS task internally). No action needed here.

  // 3. Traffic obfuscation — emits a decoy UDP packet every 20-60s.
  TrafficObfuscationManager::getInstance().tick();

  // 4. Tick all the secure-layer TTLs.
  WebAuthManager::getInstance().tick();
  SecureLayerManager::getInstance().tick();

  // 5. Idle auto-off — if no activity for AP_IDLE_TIMEOUT_MS, stop.
  if (millis() - _lastActivity >= AP_IDLE_TIMEOUT_MS) {
    stop();
  }
}

// ═══════════════════════════════════════════════════════════════════════════════
//  v5.4.3: regenerateCredentials — the "NEW SSID" button handler
// ═══════════════════════════════════════════════════════════════════════════════
//  Rotates ALL per-session credentials:
//    1. New SSID suffix (random 4 hex chars)
//    2. New WPA2 password (8 random chars from no-confusable alphabet)
//    3. New 6-digit code (via WebAuthManager::generateCode)
//
//  Then restarts the AP with the new credentials. Any connected client
//  is disconnected (they'll need to re-join with the new SSID/password).
//  The secure layer (Layer 2) is also re-initialized so existing ECDH
//  sessions are invalidated — the webapp will need to re-authenticate
//  with the new 6-digit code.
//
//  This is the nuclear-option credential rotation. Use cases:
//    - Someone saw your SSID/password on the TFT
//    - You want to force-disconnect a client without exiting AP mode
//    - You're paranoid and want fresh credentials every few minutes
// ═══════════════════════════════════════════════════════════════════════════════
bool APModeManager::_doRegenerate() {
  if (!_active) return false;

  // Tear down the web server + secure layers (but NOT the AP itself —
  // we'll restart it with new credentials below).
  if (_webServer) {
    _webServer->end();
    delete _webServer;
    _webServer = nullptr;
  }
  TrafficObfuscationManager::getInstance().end();
  HeaderObfuscationManager::getInstance().end();
  MethodTunnelingManager::getInstance().end();
  URLObfuscationManager::getInstance().end();
  SecureLayerManager::getInstance().end();
  WebAuthManager::getInstance().end();

  // Disconnect the current AP.
  WiFi.softAPdisconnect(true);

  // Generate NEW credentials.
  _generateSsid();          // new random SSID suffix
  _generateWpa2Password();  // new random 8-char password

  // Restart the AP with the new credentials.
  WiFi.mode(WIFI_AP);
  if (!WiFi.softAP(_ssid, _wpa2Password, 1, 0, AP_MAX_CLIENTS)) {
    // v5.4.7: C5 fix — on failure, do a full stop() to avoid zombie state.
    _doStop();
    return false;
  }
  WiFi.setTxPower(AP_TX_POWER_DBM);

  // v5.4.9 FIX: Restart the DNS hijack after AP interface restart.
  // softAPdisconnect(true) tears down the AP interface, which can
  // invalidate the DNS server's UDP socket binding. Without this
  // restart, new clients won't get the captive-portal pop-up.
  if (_dnsRunning) { _dnsServer.stop(); _dnsRunning = false; }
  _dnsServer.setErrorReplyCode(DNSReplyCode::NoError);
  _dnsServer.start(53, "*", WiFi.softAPIP());
  _dnsRunning = true;

  // Re-initialize the 6-layer stack with the new credentials.
  WebAuthManager::getInstance().begin();
  WebAuthManager::getInstance().generateCode();
  strncpy(_code, WebAuthManager::getInstance().code(), AP_CODE_LEN);
  _code[AP_CODE_LEN] = '\0';

  SecureLayerManager::getInstance().begin();
  URLObfuscationManager::getInstance().begin();
  MethodTunnelingManager::getInstance().begin();
  HeaderObfuscationManager::getInstance().begin();
  TrafficObfuscationManager::getInstance().begin();

  // Re-register obfuscated URL mappings.
  URLObfuscationManager::getInstance().registerEndpoint("/api/vault/list");
  URLObfuscationManager::getInstance().registerEndpoint("/api/vault/add");
  URLObfuscationManager::getInstance().registerEndpoint("/api/vault/edit");
  URLObfuscationManager::getInstance().registerEndpoint("/api/vault/delete");
  URLObfuscationManager::getInstance().registerEndpoint("/api/tunnel");
  MethodTunnelingManager::getInstance().registerTunneledEndpoint("/api/vault/edit");
  MethodTunnelingManager::getInstance().registerTunneledEndpoint("/api/vault/delete");

  // Restart the web server.
  _webServer = new WebVaultServer();
  // F6: Pass SessionContext to web server — PIN read from there.
  if (!_webServer || !_webServer->begin(_vault, _sessionCtx)) {
    // v5.4.7: C5 fix — on failure, do a full stop() to avoid zombie state.
    if (_webServer) { delete _webServer; _webServer = nullptr; }
    _doStop();
    return false;
  }

  _lastActivity = millis();
  return true;
}
