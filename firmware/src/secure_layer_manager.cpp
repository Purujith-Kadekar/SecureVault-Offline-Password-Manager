// ═══════════════════════════════════════════════════════════════════════════════
//  secure_layer_manager.cpp — Layer 2: AES-256-GCM transport encryption (v5.5.0)
//  Author: Purujith Kadekar
//  F5: Crypto Unification — XOR stream cipher replaced with AES-256-GCM
// ═══════════════════════════════════════════════════════════════════════════════
#include "secure_layer_manager.h"
#include "web_auth_manager.h"
#include "crypto_utils.h"
#include <ArduinoJson.h>
#include <cstring>

SecureLayerManager& SecureLayerManager::getInstance() {
  static SecureLayerManager instance;
  // F8: auto-initialize with warning if getInstance() called before begin()
  if (!instance._initialized) {
    Serial.println("[F8-WARN] SecureLayerManager::getInstance() called before begin() — auto-initializing");
    instance.begin();  // creates mutex, clears sessions
  }
  return instance;
}

bool SecureLayerManager::begin() {
  if (_initialized) return true;  // idempotent
  if (!_mutex) {
    _mutex = xSemaphoreCreateMutex();
    if (!_mutex) return false;
  }
  if (xSemaphoreTake(_mutex, pdMS_TO_TICKS(100))) {
    for (int i = 0; i < SL_MAX_SESSIONS; i++) {
      _clearSession(_sessions[i]);
    }
    xSemaphoreGive(_mutex);
  }
  _initialized = true;
  Serial.println("[F8] SecureLayerManager::begin() — initialized");
  return true;
}

void SecureLayerManager::end() {
  if (_mutex && xSemaphoreTake(_mutex, pdMS_TO_TICKS(100))) {
    for (int i = 0; i < SL_MAX_SESSIONS; i++) {
      _clearSession(_sessions[i]);
    }
    // v5.4.7: Also clear any pending challenges.
    for (int i = 0; i < SL_MAX_CHALLENGES; i++) {
      _clearChallenge(_challenges[i]);
    }
    xSemaphoreGive(_mutex);
  }
}

// ═══════════════════════════════════════════════════════════════════════════════
//  v5.4.7: Two-step challenge-response handshake
// ═══════════════════════════════════════════════════════════════════════════════
bool SecureLayerManager::generateChallenge(const String& clientId, String& serverNonceB64Out) {
  if (clientId.length() == 0 || clientId.length() > 64) return false;

  uint8_t nonce[16];
  secureRandom(nonce, sizeof(nonce));

  if (!xSemaphoreTake(_mutex, pdMS_TO_TICKS(200))) {
    secureZero(nonce, sizeof(nonce));
    return false;
  }

  // Find or create a challenge slot for this clientId.
  Challenge* c = _findChallenge(clientId);
  if (!c) {
    c = _findFreeChallengeSlot();
    if (!c) {
      // Evict the oldest challenge (LRU by createdAt).
      unsigned long oldest = (unsigned long)-1;
      int oldestIdx = -1;
      for (int i = 0; i < SL_MAX_CHALLENGES; i++) {
        if (_challenges[i].active && _challenges[i].createdAt < oldest) {
          oldest = _challenges[i].createdAt;
          oldestIdx = i;
        }
      }
      if (oldestIdx >= 0) _clearChallenge(_challenges[oldestIdx]);
      c = _findFreeChallengeSlot();
    }
  }
  if (!c) {
    xSemaphoreGive(_mutex);
    secureZero(nonce, sizeof(nonce));
    return false;
  }

  _clearChallenge(*c);
  strncpy(c->clientId, clientId.c_str(), 64);
  c->clientId[64] = '\0';
  memcpy(c->nonce, nonce, 16);
  c->active = true;
  c->createdAt = millis();

  xSemaphoreGive(_mutex);

  serverNonceB64Out = base64EncodeStr(nonce, sizeof(nonce));
  secureZero(nonce, sizeof(nonce));
  return true;
}

bool SecureLayerManager::establishSession(const String& clientId,
                                           const String& serverNonceB64,
                                           const String& codeProofHex) {
  if (clientId.length() == 0 || clientId.length() > 64) return false;
  if (serverNonceB64.length() == 0 || codeProofHex.length() != WAUTH_CODE_PROOF_HEX_LEN) return false;

  // Decode the serverNonce from the request.
  uint8_t nonce[16];
  size_t nonceLen = 0;
  if (!base64Decode(serverNonceB64.c_str(), serverNonceB64.length(), nonce, sizeof(nonce), &nonceLen) || nonceLen != 16) {
    return false;
  }

  // Verify the challenge exists (was generated by generateChallenge).
  // This prevents an attacker from supplying their own nonce to brute-force offline.
  if (!xSemaphoreTake(_mutex, pdMS_TO_TICKS(200))) {
    secureZero(nonce, sizeof(nonce));
    return false;
  }
  Challenge* c = _findChallenge(clientId);
  if (!c || !c->active) {
    xSemaphoreGive(_mutex);
    secureZero(nonce, sizeof(nonce));
    return false;
  }
  // Verify the nonce matches what we generated.
  if (!constantTimeEquals(c->nonce, nonce, 16)) {
    xSemaphoreGive(_mutex);
    secureZero(nonce, sizeof(nonce));
    return false;
  }
  // Challenge is consumed — clear it so it can't be reused.
  _clearChallenge(*c);
  xSemaphoreGive(_mutex);

  // Get the current 6-digit code.
  const char* code = WebAuthManager::getInstance().code();
  if (!code || strlen(code) != 6) {
    secureZero(nonce, sizeof(nonce));
    return false;
  }
  uint8_t codeBytes[6];
  memcpy(codeBytes, code, 6);

  // Compute the expected codeProof = HMAC(code, serverNonce)
  uint8_t expectedProof[32];
  hmacSha256(codeBytes, 6, nonce, 16, expectedProof);

  // Decode the client's codeProof from hex.
  uint8_t clientProof[32];
  if (hexDecode(codeProofHex.c_str(), codeProofHex.length(), clientProof, sizeof(clientProof)) != 32) {
    secureZero(codeBytes, sizeof(codeBytes));
    secureZero(nonce, sizeof(nonce));
    secureZero(expectedProof, sizeof(expectedProof));
    return false;
  }

  // Constant-time comparison.
  bool proofOk = constantTimeEquals(expectedProof, clientProof, 32);

  secureZero(clientProof, sizeof(clientProof));
  secureZero(expectedProof, sizeof(expectedProof));

  if (!proofOk) {
    secureZero(codeBytes, sizeof(codeBytes));
    secureZero(nonce, sizeof(nonce));
    return false;
  }

  // Derive encKey + macKey from the code + serverNonce.
  uint8_t encInput[16 + 3];
  memcpy(encInput, nonce, 16);
  memcpy(encInput + 16, "enc", 3);
  uint8_t encKey[32];
  hmacSha256(codeBytes, 6, encInput, sizeof(encInput), encKey);

  uint8_t macInput[16 + 3];
  memcpy(macInput, nonce, 16);
  memcpy(macInput + 16, "mac", 3);
  uint8_t macKey[32];
  hmacSha256(codeBytes, 6, macInput, sizeof(macInput), macKey);

  secureZero(codeBytes, sizeof(codeBytes));
  secureZero(nonce, sizeof(nonce));
  secureZero(encInput, sizeof(encInput));
  secureZero(macInput, sizeof(macInput));

  // Store the session.
  if (!xSemaphoreTake(_mutex, pdMS_TO_TICKS(200))) {
    secureZero(encKey, sizeof(encKey));
    secureZero(macKey, sizeof(macKey));
    return false;
  }

  Session* s = _findSession(clientId);
  if (!s) {
    s = _findFreeSlot();
    if (!s) {
      _evictLRU();
      s = _findFreeSlot();
    }
  }
  if (!s) {
    xSemaphoreGive(_mutex);
    secureZero(encKey, sizeof(encKey));
    secureZero(macKey, sizeof(macKey));
    return false;
  }

  _clearSession(*s);
  strncpy(s->clientId, clientId.c_str(), 64);
  s->clientId[64] = '\0';
  memcpy(s->encKey, encKey, 32);
  memcpy(s->macKey, macKey, 32);
  s->active = true;
  s->rxCounter = 0;
  s->txCounter = 1;
  s->lastActivity = millis();

  secureZero(encKey, sizeof(encKey));
  secureZero(macKey, sizeof(macKey));
  xSemaphoreGive(_mutex);
  return true;
}

// ═══════════════════════════════════════════════════════════════════════════════
//  F5: AES-256-GCM encryption/decryption helpers
// ═══════════════════════════════════════════════════════════════════════════════
//  These replace the old _xorStream() method. AES-256-GCM provides both
//  confidentiality and integrity in one operation (authenticated encryption),
//  eliminating the need for a separate HMAC-SHA-256 MAC per frame.
//
//  Key = encKey (32 bytes, derived from HMAC key exchange)
//  Nonce = 12 bytes: 4 zero bytes || counter(8 bytes BE)
//        — counter is monotonically increasing, so nonce is unique per message
//  AAD = counter(8 bytes BE) — binds the counter to the ciphertext,
//        preventing an attacker from modifying the counter field
//
//  Uses the same mbedtls AES-GCM implementation as SecureSession and
//  VaultManager (aesGcmEncrypt/Decrypt from crypto_utils.h).
// ═══════════════════════════════════════════════════════════════════════════════

void SecureLayerManager::_buildGcmNonce(uint64_t counter, uint8_t nonce[12]) {
  nonce[0]  = 0x00;
  nonce[1]  = 0x00;
  nonce[2]  = 0x00;
  nonce[3]  = 0x00;
  nonce[4]  = (counter >> 56) & 0xff;
  nonce[5]  = (counter >> 48) & 0xff;
  nonce[6]  = (counter >> 40) & 0xff;
  nonce[7]  = (counter >> 32) & 0xff;
  nonce[8]  = (counter >> 24) & 0xff;
  nonce[9]  = (counter >> 16) & 0xff;
  nonce[10] = (counter >> 8)  & 0xff;
  nonce[11] = counter & 0xff;
}

void SecureLayerManager::_buildGcmAad(uint64_t counter, uint8_t aad[8]) {
  aad[0] = (counter >> 56) & 0xff;
  aad[1] = (counter >> 48) & 0xff;
  aad[2] = (counter >> 40) & 0xff;
  aad[3] = (counter >> 32) & 0xff;
  aad[4] = (counter >> 24) & 0xff;
  aad[5] = (counter >> 16) & 0xff;
  aad[6] = (counter >> 8)  & 0xff;
  aad[7] = counter & 0xff;
}

bool SecureLayerManager::_aesGcmEncrypt(const uint8_t* encKey, uint64_t counter,
                                          const uint8_t* plaintext, size_t ptLen,
                                          uint8_t* ctOut, uint8_t* tagOut) {
  uint8_t nonce[12];
  _buildGcmNonce(counter, nonce);
  uint8_t aad[8];
  _buildGcmAad(counter, aad);

  // F5: Use aesGcmEncryptAad from crypto_utils.h — the AAD variant
  // binds the counter to the ciphertext via the GCM auth tag.
  bool ok = aesGcmEncryptAad(encKey, nonce, 12, aad, 8, plaintext, ptLen, ctOut, tagOut);
  return ok;
}

bool SecureLayerManager::_aesGcmDecrypt(const uint8_t* encKey, uint64_t counter,
                                          const uint8_t* ciphertext, size_t ctLen,
                                          const uint8_t* tag,
                                          uint8_t* ptOut) {
  uint8_t nonce[12];
  _buildGcmNonce(counter, nonce);
  uint8_t aad[8];
  _buildGcmAad(counter, aad);

  // F5: Use aesGcmDecryptAad from crypto_utils.h — the AAD variant
  // verifies that the counter matches what was used during encryption.
  bool ok = aesGcmDecryptAad(encKey, nonce, 12, aad, 8, ciphertext, ctLen, tag, ptOut);
  return ok;
}


String SecureLayerManager::encryptResponseJSON(const String& clientId, const String& plaintext) {
  if (!xSemaphoreTake(_mutex, pdMS_TO_TICKS(200))) return "";
  Session* s = _findSession(clientId);
  if (!s || !s->active) {
    xSemaphoreGive(_mutex);
    return "";
  }

  size_t ptLen = plaintext.length();

  // F5: AES-256-GCM encryption — replaces XOR stream cipher.
  // Allocate buffers for ciphertext (same length as plaintext) + 16-byte tag.
  size_t ctBufLen = ptLen > 0 ? ptLen : 1;
  uint8_t* ct = (uint8_t*)malloc(ctBufLen);
  uint8_t tag[16] = {0};
  if (!ct) {
    xSemaphoreGive(_mutex);
    return "";
  }

  bool ok = _aesGcmEncrypt(s->encKey, s->txCounter,
                            (const uint8_t*)plaintext.c_str(), ptLen,
                            ct, tag);
  if (!ok) {
    secureZero(ct, ctBufLen);
    secureZero(tag, sizeof(tag));
    free(ct);
    xSemaphoreGive(_mutex);
    return "";
  }

  // Build the JSON response: {counter, iv, ct, tag}
  // iv is derived from counter (4 zero bytes || counter 8 BE), so we
  // can reconstruct it on the client side from counter alone.
  // We include it for clarity but the client also derives it from counter.
  uint8_t nonce[12];
  _buildGcmNonce(s->txCounter, nonce);

  JsonDocument doc;
  doc["counter"] = (uint32_t)s->txCounter;
  doc["iv"]  = base64EncodeStr(nonce, 12);
  doc["ct"]  = base64EncodeStr(ct, ptLen);
  doc["tag"] = base64EncodeStr(tag, 16);
  String result;
  serializeJson(doc, result);

  s->txCounter++;
  s->lastActivity = millis();

  secureZero(ct, ctBufLen);
  secureZero(tag, sizeof(tag));
  free(ct);
  xSemaphoreGive(_mutex);
  return result;
}

String SecureLayerManager::decryptRequestStr(const String& clientId, const String& bodyJson) {
  if (!xSemaphoreTake(_mutex, pdMS_TO_TICKS(200))) return "";
  Session* s = _findSession(clientId);
  if (!s || !s->active) {
    xSemaphoreGive(_mutex);
    return "";
  }

  // Parse the JSON frame.
  JsonDocument doc;
  if (deserializeJson(doc, bodyJson) != DeserializationError::Ok) {
    xSemaphoreGive(_mutex);
    return "";
  }
  uint64_t counter = (uint64_t)(doc["counter"] | 0);
  String ctB64 = doc["ct"] | "";
  String tagB64 = doc["tag"] | "";
  // The "mac" field from the old XOR-based protocol is no longer used.
  // The "iv" field is informational (derived from counter), but we
  // verify it matches our expected nonce if present.
  if (ctB64.length() == 0 || tagB64.length() == 0) {
    xSemaphoreGive(_mutex);
    return "";
  }

  // Replay protection.
  if (counter <= s->rxCounter) {
    xSemaphoreGive(_mutex);
    return "";
  }

  // Decode the ciphertext.
  size_t ctCap = ctB64.length();
  uint8_t* ct = (uint8_t*)malloc(ctCap);
  size_t ctLen = 0;
  if (!ct || !base64Decode(ctB64.c_str(), ctB64.length(), ct, ctCap, &ctLen)) {
    if (ct) free(ct);
    xSemaphoreGive(_mutex);
    return "";
  }

  // Decode the GCM authentication tag (16 bytes).
  uint8_t tag[16];
  size_t tagLen = 0;
  if (!base64Decode(tagB64.c_str(), tagB64.length(), tag, sizeof(tag), &tagLen) || tagLen != 16) {
    secureZero(ct, ctCap);
    free(ct);
    xSemaphoreGive(_mutex);
    return "";
  }

  // F5: AES-256-GCM decrypt + auth-tag verify.
  // Allocate plaintext buffer (same length as ciphertext).
  uint8_t* pt = (uint8_t*)malloc(ctLen);
  String result;
  if (pt) {
    bool ok = _aesGcmDecrypt(s->encKey, counter, ct, ctLen, tag, pt);
    if (ok) {
      result = String((const char*)pt, ctLen);
      // Only advance rxCounter + lastActivity on success.
      s->rxCounter = counter;
      s->lastActivity = millis();
    } else {
      // GCM tag mismatch — tampering, wrong key, or corrupted frame.
      result = "";
    }
    secureZero(pt, ctLen);
    free(pt);
  }
  // If pt == NULL (malloc failed), don't advance rxCounter — the client
  // can retry the same request with the same counter.

  secureZero(ct, ctCap);
  secureZero(tag, sizeof(tag));
  free(ct);
  xSemaphoreGive(_mutex);
  return result;
}

bool SecureLayerManager::isSessionValid(const String& clientId) {
  if (!xSemaphoreTake(_mutex, pdMS_TO_TICKS(50))) return false;
  Session* s = _findSession(clientId);
  bool ok = s && s->active && (millis() - s->lastActivity < SL_SESSION_TTL_MS);
  xSemaphoreGive(_mutex);
  return ok;
}

void SecureLayerManager::invalidateSession(const String& clientId) {
  if (!xSemaphoreTake(_mutex, pdMS_TO_TICKS(100))) return;
  Session* s = _findSession(clientId);
  if (s) _clearSession(*s);
  xSemaphoreGive(_mutex);
}

int SecureLayerManager::getActiveSessionCount() {
  if (!xSemaphoreTake(_mutex, pdMS_TO_TICKS(50))) return 0;
  int n = 0;
  for (int i = 0; i < SL_MAX_SESSIONS; i++) {
    if (_sessions[i].active) n++;
  }
  xSemaphoreGive(_mutex);
  return n;
}

void SecureLayerManager::tick() {
  if (!xSemaphoreTake(_mutex, pdMS_TO_TICKS(50))) return;
  unsigned long now = millis();
  for (int i = 0; i < SL_MAX_SESSIONS; i++) {
    if (_sessions[i].active && (now - _sessions[i].lastActivity >= SL_SESSION_TTL_MS)) {
      _clearSession(_sessions[i]);
    }
  }
  xSemaphoreGive(_mutex);
}

SecureLayerManager::Session* SecureLayerManager::_findSession(const String& clientId) {
  for (int i = 0; i < SL_MAX_SESSIONS; i++) {
    if (_sessions[i].active && strcmp(_sessions[i].clientId, clientId.c_str()) == 0) {
      return &_sessions[i];
    }
  }
  return nullptr;
}

SecureLayerManager::Session* SecureLayerManager::_findFreeSlot() {
  for (int i = 0; i < SL_MAX_SESSIONS; i++) {
    if (!_sessions[i].active) return &_sessions[i];
  }
  return nullptr;
}

void SecureLayerManager::_evictLRU() {
  int oldestIdx = -1;
  unsigned long oldestTime = (unsigned long)-1;
  for (int i = 0; i < SL_MAX_SESSIONS; i++) {
    if (_sessions[i].active && _sessions[i].lastActivity < oldestTime) {
      oldestTime = _sessions[i].lastActivity;
      oldestIdx = i;
    }
  }
  if (oldestIdx >= 0) _clearSession(_sessions[oldestIdx]);
}

void SecureLayerManager::_clearSession(Session& s) {
  secureZero(s.clientId, sizeof(s.clientId));
  secureZero(s.encKey, sizeof(s.encKey));
  secureZero(s.macKey, sizeof(s.macKey));
  s.active = false;
  s.rxCounter = 0;
  s.txCounter = 0;
  s.lastActivity = 0;
}

// ═══════════════════════════════════════════════════════════════════════════════
//  v5.4.7: Challenge helper functions
// ═══════════════════════════════════════════════════════════════════════════════
SecureLayerManager::Challenge* SecureLayerManager::_findChallenge(const String& clientId) {
  for (int i = 0; i < SL_MAX_CHALLENGES; i++) {
    if (_challenges[i].active && strcmp(_challenges[i].clientId, clientId.c_str()) == 0) {
      return &_challenges[i];
    }
  }
  return nullptr;
}

SecureLayerManager::Challenge* SecureLayerManager::_findFreeChallengeSlot() {
  // First, expire any challenges older than 60 seconds (challenge TTL).
  unsigned long now = millis();
  for (int i = 0; i < SL_MAX_CHALLENGES; i++) {
    if (_challenges[i].active && (now - _challenges[i].createdAt > 60000)) {
      _clearChallenge(_challenges[i]);
    }
  }
  for (int i = 0; i < SL_MAX_CHALLENGES; i++) {
    if (!_challenges[i].active) return &_challenges[i];
  }
  return nullptr;
}

void SecureLayerManager::_clearChallenge(Challenge& c) {
  secureZero(c.clientId, sizeof(c.clientId));
  secureZero(c.nonce, sizeof(c.nonce));
  c.active = false;
  c.createdAt = 0;
}
